/*
  This demonstrates promiscuous WiFi monitoring on an
  ESP32-C6. Most of this code generated by gemini.google.com.

  Seth McNeill
  2026 November 04
*/

#include <Arduino.h>
#include <Arduino_Nesso_N1.h>
#include <WiFi.h>
#include "time.h"
#include <esp_crt_bundle.h>
#include <esp_mac.h>  // to get the full 8-byte MAC address
#include "esp_wifi.h"

void wifi_sniffer_cb(void* buf, wifi_promiscuous_pkt_type_t type) {
    if (type == WIFI_PKT_MGMT || type == WIFI_PKT_DATA) {
        wifi_promiscuous_pkt_t *pkt = (wifi_promiscuous_pkt_t*)buf;
        
        int rssi = pkt->rx_ctrl.rssi;
        uint8_t channel = pkt->rx_ctrl.channel;
        
        // Detect Wi-Fi 6 (802.11ax) frames on ESP32-C6 Arduino core
        // 1. he_siga1 / he_siga2 are non-zero when HE (Wi-Fi 6) preamble is decoded
        // 2. rate > 0x80 indicates HE MCS rate encoding in ESP-IDF
        bool is_wifi6 = (pkt->rx_ctrl.he_siga1 != 0) || (pkt->rx_ctrl.he_siga2 != 0);

        // Extract Source MAC Address (bytes 10 to 15 of 802.11 header)
        uint8_t *payload = pkt->payload;
        uint8_t *mac = payload + 10;
        uint8_t frame_type = payload[0] & 0xFC;

        // Stream clean JSON over USB Serial
        Serial.printf("{\"rssi\":%d,\"chan\":%d,\"mac\":\"%02X:%02X:%02X:%02X:%02X:%02X\",\"type\":%d,\"is_wifi6\":%s}\n",
                      rssi, channel, 
                      mac[0], mac[1], mac[2], mac[3], mac[4], mac[5], 
                      frame_type, 
                      is_wifi6 ? "true" : "false");
    }
}

void setup() {
    Serial.begin(115200);
    while (!Serial && millis() < 2000);

    WiFi.mode(WIFI_STA);
    WiFi.disconnect();

    wifi_init_config_t cfg = WIFI_INIT_CONFIG_DEFAULT();
    esp_wifi_init(&cfg);
    esp_wifi_set_storage(WIFI_STORAGE_RAM);
    esp_wifi_set_mode(WIFI_MODE_STA);
    esp_wifi_start();

    esp_wifi_set_promiscuous(true);
    esp_wifi_set_promiscuous_rx_cb(&wifi_sniffer_cb);
}

void loop() {
    static uint8_t channel = 1;
    static unsigned long last_hop = 0;

    if (millis() - last_hop > 250) {
        last_hop = millis();
        channel = (channel % 13) + 1;
        esp_wifi_set_channel(channel, WIFI_SECOND_CHAN_NONE);
    }
}